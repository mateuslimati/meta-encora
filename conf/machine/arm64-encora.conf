## conf/machine/arm64-encora.conf
```bitbake
#@TYPE: Machine
#@NAME: arm64-encora

#@DESCRIPTION: Machine configuration for arm64-encora systems

PREFERRED_PROVIDER_virtual/kernel ?= "linux-yocto"
PREFERRED_VERSION_linux-yocto ?= "5.15%"

require conf/machine/include/qemu.inc
require conf/machine/include/arm/armv8a/tune-cortexa57.inc

KERNEL_IMAGETYPE = "Image"

SERIAL_CONSOLES = "115200;ttyAMA0"

# For runqemu
QB_SYSTEM_NAME = "qemu-system-aarch64"
QB_MACHINE = "-machine virt"
QB_CPU = "-cpu cortex-a57"
```
